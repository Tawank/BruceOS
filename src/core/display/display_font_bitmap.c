#include "display_font.h"

#include "display_internal.h"

/* -------------------------------------------------------------------------- */
/* Built-in font: fixed 5-wide bitmap glyphs, ASCII 32-126 plus the Latin-1   */
/* Supplement / Latin Extended-A subset this project has historically needed */
/* (Western/Central European accented letters, common quote glyphs), plus    */
/* box-drawing/block/status glyphs and the full Braille block (U+2800-28FF)  */
/* -- the symbols TUI tools like Claude Code and opencode print for panel    */
/* borders, progress spinners, and status marks.                            */
/*                                                                            */
/* Earlier revisions rendered an accented letter by drawing the plain ASCII  */
/* base glyph and stamping a hardcoded accent shape on top of it at draw     */
/* time. That collided with the base glyph's own ink for most accented      */
/* capitals -- e.g. E/O/C/S/Z/I fill row 0 solid, so an acute/grave/caron/   */
/* diaeresis drawn there just disappeared into (or smudged) the letter's top */
/* stroke instead of reading as a separate mark.                             */
/*                                                                            */
/* Every glyph here is a real, static per-codepoint bitmap instead: rows 0-1 */
/* of the cell are reserved (every s_ascii/s_extended entry has them blank)  */
/* so a diacritic always has genuine headroom, the same way lowercase        */
/* ascenders already did in the old font (x-height letters left rows 0-1     */
/* blank; capitals didn't). That makes a collision structurally impossible   */
/* rather than something to hand-verify per accent/letter combination.       */
/*                                                                            */
/* Generated by tools/gen_display_font.py -- regenerate with that script     */
/* rather than hand-editing the tables below. */
/* -------------------------------------------------------------------------- */

typedef struct {
    uint16_t codepoint;
    display__column_t columns[DISPLAY_FONT__WIDTH];
} display__extended_glyph_t;

typedef struct {
    uint16_t codepoint;
    char ascii;
} display__alias_glyph_t;

/* ASCII 32-126, dense, index = codepoint - 32. Column-major, bit0 = row 0
 * (top). */
static const display__column_t s_ascii[95][DISPLAY_FONT__WIDTH] = {
    {0x0000, 0x0000, 0x0000, 0x0000, 0x0000},
    {0x0000, 0x0000, 0x017C, 0x0000, 0x0000},
    {0x0000, 0x001C, 0x0000, 0x001C, 0x0000},
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    {0x0008, 0x0004, 0x0008, 0x0010, 0x0008},
};

/* Non-ASCII glyphs, real per-codepoint bitmaps (not synthesized at draw time):
 * accented Latin letters composed with their diacritic (see MAP above), plus
 * hand-authored/algorithmic symbol and Braille glyphs (see RAW_GLYPHS above).
 * Sorted by codepoint for binary search. */
static const display__extended_glyph_t s_extended[] = {
    {0x00C0, {0x01F0, 0x0049, 0x0046, 0x0048, 0x01F0}}, /* U+00C0 */
    {0x00C1, {0x01F0, 0x0048, 0x0046, 0x0049, 0x01F0}}, /* U+00C1 */
    {0x00C2, {0x01F0, 0x004A, 0x0047, 0x004A, 0x01F0}}, /* U+00C2 */
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    {0x28FF, {0x0000, 0x0154, 0x0000, 0x0154, 0x0000}}, /* U+28FF */
};

/* Codepoints that render identically to an existing ASCII glyph (typographic
 * quote substitutes) -- no separate bitmap needed. */
static const display__alias_glyph_t s_aliases[] = {
    {0x2018, '\''},
    {0x2019, '\''},
    {0x201C, '"'},
    {0x201D, '"'},
};

static void display_font_bitmap__fill(display__glyph_t *out_glyph, const display__column_t *columns) {
    out_glyph->width = DISPLAY_FONT__WIDTH;
    out_glyph->height = DISPLAY__FONT_HEIGHT + 1;
    out_glyph->advance = DISPLAY__FONT_WIDTH + 1;
    for (uint8_t col = 0; col < DISPLAY_FONT__WIDTH; ++col) { out_glyph->columns[col] = columns[col]; }
}

static bool display_font_bitmap__get_glyph(uint32_t codepoint, display__glyph_t *out_glyph) {
    if (codepoint >= DISPLAY__FONT_FIRST && codepoint <= DISPLAY__FONT_LAST) {
        display_font_bitmap__fill(out_glyph, s_ascii[codepoint - DISPLAY__FONT_FIRST]);
        return true;
    }

    /* s_extended[] is sorted by codepoint; binary search it. */
    size_t lo = 0, hi = sizeof(s_extended) / sizeof(s_extended[0]);
    while (lo < hi) {
        size_t mid = lo + (hi - lo) / 2;
        if (s_extended[mid].codepoint == codepoint) {
            display_font_bitmap__fill(out_glyph, s_extended[mid].columns);
            return true;
        }
        if (s_extended[mid].codepoint < codepoint) lo = mid + 1;
        else hi = mid;
    }

    for (size_t i = 0; i < sizeof(s_aliases) / sizeof(s_aliases[0]); ++i) {
        if (s_aliases[i].codepoint == codepoint) {
            return display_font_bitmap__get_glyph((uint32_t)(unsigned char)s_aliases[i].ascii, out_glyph);
        }
    }

    return false;
}

const display__font_t *display_font_bitmap__instance(void) {
    static const display__font_t s_font = {
        .name = "bruce-5x10",
        .cell_width = DISPLAY__FONT_WIDTH + 1,
        .cell_height = DISPLAY__FONT_HEIGHT + 1,
        .get_glyph = display_font_bitmap__get_glyph,
    };
    return &s_font;
}
