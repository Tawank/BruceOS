## src/Kconfig.projbuild
```kconfig
menu "Bruce hardware configuration"

    config BRUCE_QEMU_TEST_MODE
        bool "QEMU self-test mode"
        default n
        help
            Skip physical display and input initialization and expose the
            serial self-test protocol used by the QEMU pytest suite.

    config BRUCE_POWER_HOLD_GPIO
        int "Power hold GPIO"
        default -1
        range -1 48
        help
            Some boards (e.g. LilyGO T-Display S3) need a GPIO driven high
            at boot to latch their power circuit on / enable the battery
            sense path; left low or floating, the board can shut itself
            back off or read a bogus battery voltage. Driven high once,
            very early in app_main(), before storage/display init. -1 if
            the board doesn't need this.

    menu "Board I2C bus"
        config BRUCE_BOARD_I2C_ENABLED
            bool "Shared I2C bus for PMIC/touch/GPIO-expander available"
            default n
            help
                A single I2C bus used internally by HAL drivers - the
                battery PMIC backend, the backlight GPIO-expander backend,
                and the touch input driver - each guarded by its own enable
                option below/elsewhere. This is separate from core/i2c.c's
                permission-gated, app-facing I2C API: it's a bus owned
                directly by these drivers, the same way the display driver
                owns its own SPI bus.

        config BRUCE_BOARD_I2C_SDA_GPIO
            int "Board I2C SDA GPIO"
            depends on BRUCE_BOARD_I2C_ENABLED
            default 21
            range 0 48

        config BRUCE_BOARD_I2C_SCL_GPIO
            int "Board I2C SCL GPIO"
            depends on BRUCE_BOARD_I2C_ENABLED
            default 22
            range 0 48

        config BRUCE_BOARD_I2C_FREQ_HZ
            int "Board I2C clock (Hz)"
            depends on BRUCE_BOARD_I2C_ENABLED
            default 400000
            range 100000 1000000
    endmenu

    menu "Display"
        config BRUCE_DISPLAY_WIDTH
            int "Panel native width (px)"
            default 135
            help
                Native panel width before rotation, i.e. the shorter side on
                every board shipped so far (both use a 135x240 ST7789V2).

        config BRUCE_DISPLAY_HEIGHT
            int "Panel native height (px)"
            default 240

        config BRUCE_DISPLAY_DEFAULT_ROTATION
            int "Default rotation"
            default 1
            range 0 3
            help
                0-3, passed to display_driver__configure_rotation(). Rotation
                1/3 swap X/Y (landscape); 0/2 do not (portrait).

        choice BRUCE_DISPLAY_PANEL_CONTROLLER
            prompt "LCD panel controller"
            default BRUCE_DISPLAY_PANEL_ST7789
            help
                Which display controller chip the panel uses. Both are driven
                over an interface (see BRUCE_DISPLAY_BUS below); their init
                sequences and addressable-RAM layout differ.

            config BRUCE_DISPLAY_PANEL_ST7789
                bool "ST7789 / ST7789V2"

            config BRUCE_DISPLAY_PANEL_ILI9341
                bool "ILI9341"
        endchoice

        choice BRUCE_DISPLAY_BUS
            prompt "LCD bus"
            default BRUCE_DISPLAY_BUS_SPI
            help
                Most boards wire the panel over SPI; some (e.g. the LilyGO
                T-Display S3) use an 8-bit parallel (Intel 8080/i80) bus
                instead. This changes which of the pin options below apply.

            config BRUCE_DISPLAY_BUS_SPI
                bool "SPI"

            config BRUCE_DISPLAY_BUS_I80
                bool "8-bit parallel (i80)"
        endchoice

        config BRUCE_DISPLAY_SPI_HOST
            int "LCD SPI host"
            depends on BRUCE_DISPLAY_BUS_SPI
            default 1
            range 0 2
            help
                Numeric spi_host_device_t value (SPI1_HOST=0, SPI2_HOST=1,
                SPI3_HOST=2) the LCD panel is wired to.

        config BRUCE_DISPLAY_PIN_MOSI
            int "LCD MOSI GPIO"
            depends on BRUCE_DISPLAY_BUS_SPI
            default 35
            range 0 48

        config BRUCE_DISPLAY_PIN_SCK
            int "LCD SCK GPIO"
            depends on BRUCE_DISPLAY_BUS_SPI
            default 36
            range 0 48

        config BRUCE_DISPLAY_SPI_PCLK_HZ
            int "LCD SPI clock (Hz)"
            depends on BRUCE_DISPLAY_BUS_SPI
            default 40000000
            range 1000000 80000000
            help
                40 MHz is a conservative default that works on short,
                PCB-routed traces. Many ST7789/ILI9341 panels are rated for
                60-80 MHz and raising this shortens every frame transfer;
                lower it instead on jumper-wired prototypes or long/noisy
                SPI runs if the panel shows tearing or garbage pixels.

        config BRUCE_DISPLAY_PIN_D0
            int "LCD i80 data GPIO 0"
            depends on BRUCE_DISPLAY_BUS_I80
            default 39
            range 0 48

        config BRUCE_DISPLAY_PIN_D1
            int "LCD i80 data GPIO 1"
            depends on BRUCE_DISPLAY_BUS_I80
            default 40
            range 0 48

        config BRUCE_DISPLAY_PIN_D2
            int "LCD i80 data GPIO 2"
            depends on BRUCE_DISPLAY_BUS_I80
            default 41
            range 0 48

        config BRUCE_DISPLAY_PIN_D3
            int "LCD i80 data GPIO 3"
            depends on BRUCE_DISPLAY_BUS_I80
            default 42
            range 0 48

        config BRUCE_DISPLAY_PIN_D4
            int "LCD i80 data GPIO 4"
            depends on BRUCE_DISPLAY_BUS_I80
            default 45
            range 0 48

        config BRUCE_DISPLAY_PIN_D5
            int "LCD i80 data GPIO 5"
            depends on BRUCE_DISPLAY_BUS_I80
            default 46
            range 0 48

        config BRUCE_DISPLAY_PIN_D6
            int "LCD i80 data GPIO 6"
            depends on BRUCE_DISPLAY_BUS_I80
            default 47
            range 0 48

        config BRUCE_DISPLAY_PIN_D7
            int "LCD i80 data GPIO 7"
            depends on BRUCE_DISPLAY_BUS_I80
            default 48
            range 0 48

        config BRUCE_DISPLAY_PIN_WR
            int "LCD i80 WR (write strobe) GPIO"
            depends on BRUCE_DISPLAY_BUS_I80
            default 8
            range 0 48

        config BRUCE_DISPLAY_I80_PCLK_HZ
            int "LCD i80 pixel clock (Hz)"
            depends on BRUCE_DISPLAY_BUS_I80
            default 10000000
            range 1000000 20000000
            help
                Parallel-bus timing is stricter than SPI's; 10 MHz is a
                conservative default that works on jumper-wired prototypes
                as well as PCB-routed boards. Raise it if the panel supports
                a faster write cycle and the wiring is short/clean.

        config BRUCE_DISPLAY_PIN_CS
            int "LCD CS GPIO"
            default 37
            range 0 48

        config BRUCE_DISPLAY_PIN_DC
            int "LCD DC GPIO"
            default 34
            range 0 48

        config BRUCE_DISPLAY_PIN_RST
            int "LCD RST GPIO"
            default 33
            range -1 48
            help
                -1 if the panel has no reset line wired to a GPIO (the
                driver falls back to a software reset command in that case).

        config BRUCE_DISPLAY_PIN_BL
            int "LCD backlight GPIO"
            default 38
            range -1 48
            help
                -1 if the panel's backlight is not switched through a GPIO
                Bruce can drive directly - e.g. tied to a PMIC rail that is
                always on once powered, or gated through an I2C GPIO
                expander (see BRUCE_DISPLAY_BACKLIGHT_I2C_EXPANDER_ENABLED
                below). Either way the driver skips backlight PWM setup.

        config BRUCE_DISPLAY_BACKLIGHT_I2C_EXPANDER_ENABLED
            bool "Backlight enabled via I2C GPIO expander (AW9523)"
            depends on BRUCE_BOARD_I2C_ENABLED
            default n
            help
                Some boards (e.g. M5Stack CoreS3) gate their backlight boost
                converter through a pin on an AW9523 I2C GPIO expander
                rather than a GPIO Bruce can drive directly - leave
                BRUCE_DISPLAY_PIN_BL at -1 in that case. This performs a
                single one-time enable write at display init; the backlight
                is not dimmable through this path.

        config BRUCE_DISPLAY_BACKLIGHT_I2C_ADDR
            hex "Backlight I2C GPIO expander address"
            depends on BRUCE_DISPLAY_BACKLIGHT_I2C_EXPANDER_ENABLED
            default 0x58

        config BRUCE_DISPLAY_BACKLIGHT_I2C_BIT
            int "Backlight enable bit (AW9523 P1.x)"
            depends on BRUCE_DISPLAY_BACKLIGHT_I2C_EXPANDER_ENABLED
            default 7
            range 0 7
            help
                Which bit of the AW9523's P1 output register (register
                0x03) to set. Only P1 (not P0) is supported, since that is
                what every known board wires the backlight boost-enable
                pin to.

        config BRUCE_DISPLAY_BACKLIGHT_AXP192_LDO2_ENABLED
            bool "Backlight powered from AXP192 LDO2 (M5Stack Core2 and similar)"
            depends on BRUCE_BOARD_I2C_ENABLED
            default n
            help
                Some boards (e.g. M5Stack Core2) power their backlight
                (and often the LCD/SD logic rail too) from the AXP192
                PMIC's LDO2 output rather than a GPIO - leave
                BRUCE_DISPLAY_PIN_BL at -1 in that case. This sets LDO2 to
                3.3V and enables it once at display init; not dimmable
                through this path.

        config BRUCE_DISPLAY_BACKLIGHT_AXP192_I2C_ADDR
            hex "AXP192 I2C address (backlight)"
            depends on BRUCE_DISPLAY_BACKLIGHT_AXP192_LDO2_ENABLED
            default 0x34

        # ST7789's addressable RAM is a fixed 240x320; a physically smaller
        # panel is offset within it, and the offset swaps per rotation. These
        # four (x, y) pairs are the same per-panel constants TFT_eSPI ships in
        # TFT_Drivers/ST7789_Rotation.h for each known panel size - e.g. the
        # 135x240 panel (Cardputer/StickC Plus2, defaults below) needs a
        # different table than the 170x320 panel some other boards use.
        config BRUCE_DISPLAY_GAP_X_ROTATION0
            int "Panel gap X, rotation 0 (portrait)"
            default 52
            range 0 200

        config BRUCE_DISPLAY_GAP_Y_ROTATION0
            int "Panel gap Y, rotation 0 (portrait)"
            default 40
            range 0 200

        config BRUCE_DISPLAY_GAP_X_ROTATION1
            int "Panel gap X, rotation 1 (landscape)"
            default 40
            range 0 200

        config BRUCE_DISPLAY_GAP_Y_ROTATION1
            int "Panel gap Y, rotation 1 (landscape)"
            default 53
            range 0 200

        config BRUCE_DISPLAY_GAP_X_ROTATION2
            int "Panel gap X, rotation 2 (portrait, inverted)"
            default 53
            range 0 200

        config BRUCE_DISPLAY_GAP_Y_ROTATION2
            int "Panel gap Y, rotation 2 (portrait, inverted)"
            default 40
            range 0 200

        config BRUCE_DISPLAY_GAP_X_ROTATION3
            int "Panel gap X, rotation 3 (landscape, inverted)"
            default 40
            range 0 200

        config BRUCE_DISPLAY_GAP_Y_ROTATION3
            int "Panel gap Y, rotation 3 (landscape, inverted)"
            default 52
            range 0 200
    endmenu

    menu "Audio"
        choice BRUCE_AUDIO_BACKEND
            prompt "Audio output backend"
            default BRUCE_AUDIO_BACKEND_I2S
            help
                Boards wire audio output very differently: an I2S DAC, a
                GPIO driven through LEDC as a PWM buzzer, or nothing at all.

            config BRUCE_AUDIO_BACKEND_NONE
                bool "None"

            config BRUCE_AUDIO_BACKEND_I2S
                bool "I2S DAC"

            config BRUCE_AUDIO_BACKEND_LEDC_BUZZER
                bool "LEDC PWM buzzer"
        endchoice

        config BRUCE_AUDIO_I2S_BCLK_GPIO
            int "I2S BCLK GPIO"
            depends on BRUCE_AUDIO_BACKEND_I2S
            default 41
            range 0 48

        config BRUCE_AUDIO_I2S_DATA_GPIO
            int "I2S DATA (DOUT) GPIO"
            depends on BRUCE_AUDIO_BACKEND_I2S
            default 42
            range 0 48

        config BRUCE_AUDIO_I2S_LRCLK_GPIO
            int "I2S LRCLK (WS) GPIO"
            depends on BRUCE_AUDIO_BACKEND_I2S
            default 43
            range 0 48

        config BRUCE_AUDIO_BUZZER_GPIO
            int "Buzzer GPIO"
            depends on BRUCE_AUDIO_BACKEND_LEDC_BUZZER
            range 0 48
    endmenu

    menu "Battery"
        config BRUCE_BATTERY_ENABLED
            bool "Battery voltage sense available"
            default y

        choice BRUCE_BATTERY_BACKEND
            prompt "Battery sense backend"
            depends on BRUCE_BATTERY_ENABLED
            default BRUCE_BATTERY_BACKEND_ADC
            help
                Most boards expose a raw ADC1 channel across a voltage
                divider. Some (M5Stack CoreS3/Core2/StickC-family) instead
                have an AXP2101 PMIC with a built-in fuel gauge, read over
                the shared board I2C bus. Others (LilyGO T-Embed CC1101) use
                a standalone BQ27220 fuel-gauge IC on that same bus instead
                of a PMIC.

            config BRUCE_BATTERY_BACKEND_ADC
                bool "Raw ADC1 channel"

            config BRUCE_BATTERY_BACKEND_AXP2101
                bool "AXP2101 PMIC (I2C)"
                depends on BRUCE_BOARD_I2C_ENABLED

            config BRUCE_BATTERY_BACKEND_AXP192
                bool "AXP192 PMIC (I2C)"
                depends on BRUCE_BOARD_I2C_ENABLED
                help
                    Older M5Stack family PMIC (Core2, and others). Unlike
                    AXP2101 this has no direct battery-percentage register -
                    it reports raw battery voltage (register 0x78/0x79),
                    converted to a percentage with the same linear
                    empty/full millivolt estimate as the ADC backend.

            config BRUCE_BATTERY_BACKEND_BQ27220
                bool "BQ27220 fuel gauge (I2C)"
                depends on BRUCE_BOARD_I2C_ENABLED
                help
                    TI BQ27220 standalone fuel-gauge IC (e.g. LilyGO
                    T-Embed CC1101). Like AXP2101 this has a direct
                    battery-percentage command - StateOfCharge(), standard
                    command 0x2C, a 16-bit little-endian 0-100 value - so no
                    voltage-to-percent math is needed.
        endchoice

        config BRUCE_BATTERY_ADC_CHANNEL
            int "Battery sense ADC1 channel"
            depends on BRUCE_BATTERY_ENABLED && BRUCE_BATTERY_BACKEND_ADC
            default 9
            range 0 9

        config BRUCE_BATTERY_AXP2101_I2C_ADDR
            hex "AXP2101 I2C address"
            depends on BRUCE_BATTERY_ENABLED && BRUCE_BATTERY_BACKEND_AXP2101
            default 0x34

        config BRUCE_BATTERY_AXP192_I2C_ADDR
            hex "AXP192 I2C address"
            depends on BRUCE_BATTERY_ENABLED && BRUCE_BATTERY_BACKEND_AXP192
            default 0x34

        config BRUCE_BATTERY_BQ27220_I2C_ADDR
            hex "BQ27220 I2C address"
            depends on BRUCE_BATTERY_ENABLED && BRUCE_BATTERY_BACKEND_BQ27220
            default 0x55
    endmenu

    menu "SD card"
        config BRUCE_SD_ENABLED
            bool "SD card slot available"
            default y

        config BRUCE_SD_SPI_HOST
            int "SD card SPI host"
            depends on BRUCE_SD_ENABLED
            default 2
            range 0 2
            help
                Numeric spi_host_device_t value. Bruce's radio peripherals
                (core/spi/spi.c) fix their bus to SPI3_HOST (2); boards that
                share that bus with the SD card (as the Cardputer does over
                its Grove port) should use the same value here.

        config BRUCE_SD_PIN_MOSI
            int "SD card MOSI GPIO"
            depends on BRUCE_SD_ENABLED
            default 14
            range 0 48

        config BRUCE_SD_PIN_MISO
            int "SD card MISO GPIO"
            depends on BRUCE_SD_ENABLED
            default 39
            range 0 48

        config BRUCE_SD_PIN_SCK
            int "SD card SCK GPIO"
            depends on BRUCE_SD_ENABLED
            default 40
            range 0 48

        config BRUCE_SD_PIN_CS
            int "SD card CS GPIO"
            depends on BRUCE_SD_ENABLED
            default 12
            range 0 48
    endmenu

    menu "Input"
        config BRUCE_INPUT_POLL_PERIOD_MS
            int "Input poll period (ms)"
            default 20
            range 5 100
            help
                Period between physical input polls. Lower values reduce
                latency but use more CPU.

        config BRUCE_INPUT_DEBOUNCE_MS
            int "Input debounce time (ms)"
            default 30
            range 10 200
            help
                Minimum time between accepted state changes for a single
                button or key. Increase this if you see spurious repeated
                events.

        config BRUCE_BUTTON_SELECT_ENABLED
            bool "Select button available"
            default y
            help
                A single central/select button, reported as
                BRUCE_INPUT_CODE_SELECT (e.g. the Cardputer's G0 button).

        config BRUCE_BUTTON_SELECT_GPIO
            int "Select button GPIO"
            depends on BRUCE_BUTTON_SELECT_ENABLED
            default 0
            range 0 48

        config BRUCE_BUTTON_A_ENABLED
            bool "Button A available"
            default n

        config BRUCE_BUTTON_A_GPIO
            int "Button A GPIO"
            depends on BRUCE_BUTTON_A_ENABLED
            range 0 48

        config BRUCE_BUTTON_B_ENABLED
            bool "Button B available"
            default n

        config BRUCE_BUTTON_B_GPIO
            int "Button B GPIO"
            depends on BRUCE_BUTTON_B_ENABLED
            range 0 48

        config BRUCE_BUTTON_C_ENABLED
            bool "Button C available"
            default n

        config BRUCE_BUTTON_C_GPIO
            int "Button C GPIO"
            depends on BRUCE_BUTTON_C_ENABLED
            range 0 48

        config BRUCE_BUTTON_D_ENABLED
            bool "Button D available"
            default n
            help
                A fifth discrete button, for boards with more than
                select/A/B/C (e.g. xk404's 5-button d-pad-style layout).
                Reported as BRUCE_INPUT_CODE_BUTTON_X, since core_sdk/input.h
                has no dedicated "D" code.

        config BRUCE_BUTTON_D_GPIO
            int "Button D GPIO"
            depends on BRUCE_BUTTON_D_ENABLED
            range 0 48

        config BRUCE_KEYBOARD_ENABLED
            bool "GPIO matrix keyboard available"
            default y
            help
                A 3-output/7-input GPIO scan matrix keyboard, wired and
                decoded the way the Cardputer's keyboard is. A board with a
                different keyboard peripheral (e.g. an I2C co-processor, as
                on the LilyGO T-Deck) needs its own driver, not this option.

        config BRUCE_INPUT_SCAN_SETTLE_US
            int "Keyboard scan settle time (us)"
            default 30
            range 10 200
            depends on BRUCE_KEYBOARD_ENABLED
            help
                Delay after changing the keyboard scan outputs before reading
                the sense lines. Increase this if keys are missed.

        config BRUCE_KEYBOARD_AUTODETECT_ALT
            bool "Autodetect alternate IN0/IN1 pins"
            depends on BRUCE_KEYBOARD_ENABLED
            default y
            help
                Some Cardputer keyboard membranes use a different pair of
                sense pins for the first column; when enabled, the scanner
                falls back to BRUCE_KEYBOARD_IN_ALT*_GPIO if the primary pins
                read nothing.

        config BRUCE_KEYBOARD_OUT0_GPIO
            int "Keyboard OUT0 GPIO"
            depends on BRUCE_KEYBOARD_ENABLED
            default 8
            range 0 48

        config BRUCE_KEYBOARD_OUT1_GPIO
            int "Keyboard OUT1 GPIO"
            depends on BRUCE_KEYBOARD_ENABLED
            default 9
            range 0 48

        config BRUCE_KEYBOARD_OUT2_GPIO
            int "Keyboard OUT2 GPIO"
            depends on BRUCE_KEYBOARD_ENABLED
            default 11
            range 0 48

        config BRUCE_KEYBOARD_IN0_GPIO
            int "Keyboard IN0 GPIO"
            depends on BRUCE_KEYBOARD_ENABLED
            default 13
            range 0 48

        config BRUCE_KEYBOARD_IN1_GPIO
            int "Keyboard IN1 GPIO"
            depends on BRUCE_KEYBOARD_ENABLED
            default 15
            range 0 48

        config BRUCE_KEYBOARD_IN2_GPIO
            int "Keyboard IN2 GPIO"
            depends on BRUCE_KEYBOARD_ENABLED
            default 3
            range 0 48

        config BRUCE_KEYBOARD_IN3_GPIO
            int "Keyboard IN3 GPIO"
            depends on BRUCE_KEYBOARD_ENABLED
            default 4
            range 0 48

        config BRUCE_KEYBOARD_IN4_GPIO
            int "Keyboard IN4 GPIO"
            depends on BRUCE_KEYBOARD_ENABLED
            default 5
            range 0 48

        config BRUCE_KEYBOARD_IN5_GPIO
            int "Keyboard IN5 GPIO"
            depends on BRUCE_KEYBOARD_ENABLED
            default 6
            range 0 48

        config BRUCE_KEYBOARD_IN6_GPIO
            int "Keyboard IN6 GPIO"
            depends on BRUCE_KEYBOARD_ENABLED
            default 7
            range 0 48

        config BRUCE_KEYBOARD_IN_ALT0_GPIO
            int "Keyboard alternate IN0 GPIO"
            depends on BRUCE_KEYBOARD_AUTODETECT_ALT
            default 1
            range 0 48

        config BRUCE_KEYBOARD_IN_ALT1_GPIO
            int "Keyboard alternate IN1 GPIO"
            depends on BRUCE_KEYBOARD_AUTODETECT_ALT
            default 2
            range 0 48

        config BRUCE_KEYBOARD_IN_ALT2_GPIO
            int "Keyboard alternate IN2 GPIO"
            depends on BRUCE_KEYBOARD_AUTODETECT_ALT
            default 3
            range 0 48

        config BRUCE_KEYBOARD_IN_ALT3_GPIO
            int "Keyboard alternate IN3 GPIO"
            depends on BRUCE_KEYBOARD_AUTODETECT_ALT
            default 4
            range 0 48

        config BRUCE_KEYBOARD_IN_ALT4_GPIO
            int "Keyboard alternate IN4 GPIO"
            depends on BRUCE_KEYBOARD_AUTODETECT_ALT
            default 5
            range 0 48

        config BRUCE_KEYBOARD_IN_ALT5_GPIO
            int "Keyboard alternate IN5 GPIO"
            depends on BRUCE_KEYBOARD_AUTODETECT_ALT
            default 6
            range 0 48

        config BRUCE_KEYBOARD_IN_ALT6_GPIO
            int "Keyboard alternate IN6 GPIO"
            depends on BRUCE_KEYBOARD_AUTODETECT_ALT
            default 7
            range 0 48
    endmenu

    menu "Rotary encoder"
        config BRUCE_ENCODER_ENABLED
            bool "Quadrature rotary encoder available"
            default n
            help
                A mechanical quadrature rotary encoder (e.g. M5Stack
                DinMeter's control knob), decoded in software and
                synthesized as BRUCE_INPUT_CODE_UP/DOWN button presses -
                one pair of pins per detent, direction-dependent - so every
                existing menu that already handles up/down navigation
                works with no app-side changes. The encoder's own push
                button (if it has one) is a normal button - wire it to
                BRUCE_BUTTON_SELECT_GPIO or another button slot, not here.

        config BRUCE_ENCODER_PIN_A
            int "Encoder A (quadrature) GPIO"
            depends on BRUCE_ENCODER_ENABLED
            range 0 48

        config BRUCE_ENCODER_PIN_B
            int "Encoder B (quadrature) GPIO"
            depends on BRUCE_ENCODER_ENABLED
            range 0 48
    endmenu

    menu "Touch"
        config BRUCE_TOUCH_ENABLED
            bool "Touchscreen available (FT5x06/FT6336 family, I2C)"
            depends on BRUCE_BOARD_I2C_ENABLED
            default n
            help
                Reports taps as BRUCE_INPUT_TOUCH events (code=x, value=y)
                on the same queue as buttons/keyboard - see
                core_sdk/input.h. Boards whose only input is a touchscreen
                (e.g. M5Stack CoreS3, which has no physical buttons at all)
                need this; apps that want to be usable there must listen
                for BRUCE_INPUT_TOUCH themselves, same as
                BRUCE_INPUT_BUTTON/KEY are handled today.

        config BRUCE_TOUCH_I2C_ADDR
            hex "Touch controller I2C address"
            depends on BRUCE_TOUCH_ENABLED
            default 0x38

        config BRUCE_TOUCH_PIN_RST
            int "Touch controller RESET GPIO"
            depends on BRUCE_TOUCH_ENABLED
            default -1
            range -1 48
            help
                -1 if not wired to its own GPIO (e.g. shares the panel's
                reset line, or has none).

        config BRUCE_TOUCH_PIN_INT
            int "Touch controller INT GPIO"
            depends on BRUCE_TOUCH_ENABLED
            default -1
            range -1 48
            help
                -1 to poll on BRUCE_INPUT_POLL_PERIOD_MS instead of using
                the interrupt line.

        config BRUCE_TOUCH_SWAP_XY
            bool "Swap X/Y"
            depends on BRUCE_TOUCH_ENABLED
            default n
            help
                Set these three to match whatever
                BRUCE_DISPLAY_DEFAULT_ROTATION applies to the panel (see the
                swap_xy/mirror_x/mirror_y used for the same rotation in
                display_driver__configure_rotation()) - touch coordinates
                are not re-mapped if the app changes rotation at runtime.

        config BRUCE_TOUCH_MIRROR_X
            bool "Mirror X"
            depends on BRUCE_TOUCH_ENABLED
            default n

        config BRUCE_TOUCH_MIRROR_Y
            bool "Mirror Y"
            depends on BRUCE_TOUCH_ENABLED
            default n
    endmenu

    menu "Infrared"
        config BRUCE_IR_TX_GPIO
            int "Infrared transmit GPIO"
            default 44
            range 0 48
            help
                GPIO connected to the active-high infrared transmitter.

        config BRUCE_IR_RX_GPIO
            int "Infrared receive GPIO"
            default 1
            range 0 48
            help
                GPIO connected to the active-low infrared receiver output.
    endmenu

    menu "NRF24"
        config BRUCE_NRF24_SCK_GPIO
            int "NRF24 SPI clock GPIO"
            default 40
            range 0 48

        config BRUCE_NRF24_MISO_GPIO
            int "NRF24 SPI MISO GPIO"
            default 39
            range 0 48

        config BRUCE_NRF24_MOSI_GPIO
            int "NRF24 SPI MOSI GPIO"
            default 14
            range 0 48

        config BRUCE_NRF24_CS_GPIO
            int "NRF24 chip-select GPIO"
            default 1
            range 0 48

        config BRUCE_NRF24_CE_GPIO
            int "NRF24 chip-enable GPIO"
            default 2
            range 0 48
            help
                NRF24 defaults match the external SPI wiring used by Bruce
                legacy builds. The radio uses SPI3_HOST; IRQ is not required.
    endmenu

endmenu
```
